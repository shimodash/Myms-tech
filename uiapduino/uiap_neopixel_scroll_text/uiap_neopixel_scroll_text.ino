#include <Adafruit_NeoPixel.h>

#define PIN 6
#define NUM_PIXELS 64

// 8x8ドットフォントデータ (ASCII 32-126)
const PROGMEM byte font8x8[][8] = {
  {0x00, 0x00, 0x00, 0x00, 0x00, 0x00, 0x00, 0x00}, // 32 ' '
  {0x00, 0x00, 0x5F, 0x00, 0x00, 0x00, 0x00, 0x00}, // 33 '!'
  {0x00, 0x07, 0x00, 0x07, 0x00, 0x00, 0x00, 0x00}, // 34 '"'
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  {0x08, 0x14, 0x08, 0x14, 0x08, 0x00, 0x00, 0x00}, // 126 '~'
};

Adafruit_NeoPixel pixels(NUM_PIXELS, PIN, NEO_GRB + NEO_KHZ800);

// マトリックス座標をLEDインデックスに変換
int xy_to_pixel_index(int x, int y) {
  if (x < 0 || x >= 8 || y < 0 || y >= 8) {
    return -1; // 範囲外
  }
  return y * 8 + x;
}

// 8x8マトリックスに1文字を表示
void draw_char(char c, int offset_x, int offset_y, uint32_t color) {
  int char_index = c - 32;
  if (char_index < 0 || char_index >= sizeof(font8x8) / sizeof(font8x8[0])) {
    c = ' ';
    char_index = c - 32;
  }

  const byte* character = font8x8[char_index];
  
  for (int y = 0; y < 8; y++) {
    for (int x = 0; x < 8; x++) {
      if (character[y] & (1 << (7 - x))) {
        int pixel_index = xy_to_pixel_index(x + offset_x, y + offset_y);
        if (pixel_index != -1) {
          pixels.setPixelColor(pixel_index, color);
        }
      }
    }
  }
}

// 8x8マトリックスに文字列をスクロール表示
void draw_string(const char* str, int offset_x, int offset_y, uint32_t color) {
  for (int i = 0; str[i] != '\0'; i++) {
    draw_char(str[i], offset_x, offset_y + i * 8, color);
  }
}

void setup() {
  // for seamless switch 
  if (FLASH->STATR & (1<<14)) NVIC_SystemReset();
  SystemReset_StartMode(Start_Mode_BOOT);
  pinMode(PD4, OUTPUT);

  pixels.begin();
  pixels.setBrightness(50);
  pixels.clear();
  pixels.show();
}

void loop() {
  const char* text = "uiapduino demo";
  int text_length = 14; // "text"の文字数
  int scroll_speed = 70; // スクロール速度 (小さいほど速い)

  // スクロールオフセットを計算
  for (int offset_y = 8; offset_y >= -(text_length * 8); offset_y--) {
    pixels.clear();
    draw_string(text, 0, offset_y, pixels.Color(50, 80, 235)); // 文字色を緑に設定
    pixels.show();
    delay(scroll_speed);
  }
}
